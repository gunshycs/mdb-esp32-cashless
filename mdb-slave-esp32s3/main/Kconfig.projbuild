## mdb-slave-esp32s3/main/Kconfig.projbuild
```kconfig
menu "VMflow"

menu "MDB Cashless Device"

    choice
        prompt "Peripheral Addresses"
        default CASHLESS_ADDR_1

        config CASHLESS_ADDR_1
            bool "Cashless Device #1"

        config CASHLESS_ADDR_2
            bool "Cashless Device #2"

    endchoice

    config CASHLESS_DEVICE_ADDRESS
        int
        default 16 if CASHLESS_ADDR_1
        default 96 if CASHLESS_ADDR_2

    choice
        prompt "Country / Currency Code"
        default CURRENCY_UNKNOWN

        config CURRENCY_EUR
            bool "EUR - 0x0978"

        config CURRENCY_USD
            bool "USD - 0x0840"

        config CURRENCY_BRL
            bool "BRL - 0x0986"

        config CURRENCY_UNKNOWN
            bool "UNKNOWN - 0xffff"
    endchoice

    config MDB_CURRENCY_CODE
        int
        default 6520 if CURRENCY_EUR
        default 6208 if CURRENCY_USD
        default 6534 if CURRENCY_BRL
        default 65535 if CURRENCY_UNKNOWN

    choice
        prompt "Scale Factor (MDB)"
        default SCALE_FACTOR_1

        config SCALE_FACTOR_1
            bool "1"

        config SCALE_FACTOR_10
            bool "10"

        config SCALE_FACTOR_100
            bool "100"

    endchoice

    config MDB_SCALE_FACTOR
        int
        default 1 if SCALE_FACTOR_1
        default 10 if SCALE_FACTOR_10
        default 100 if SCALE_FACTOR_100

    config MDB_DECIMAL_PLACES
        int "Decimal Places (MDB)"
        default 2
        range 0 3

    config VMFLOW_SESSION_TIMEOUT_S
        int "Session idle timeout (seconds)"
        default 60
        range 10 600
        help
            After BEGIN SESSION, if no product is selected within this time the reader
            sends SESSION CANCEL and reports "end,timeout". Keep the backend's
            payment-authorization cancel timer slightly longer than this.

    config VMFLOW_MDB_DIAG
        bool "MDB diagnostics (TX line test + traffic counters)"
        default n
        help
            Bench aid, keep off in production. At boot, before MDB starts, the TX
            optocoupler is held ON (line pulled low) then OFF for 10 s each, three
            times, so MDB pin 4 (Master Receive) vs pin 6 (Common) can be measured
            with a multimeter. Then logs every 5 s how many commands the VMC sent to
            this address (RESET/SETUP/POLL/...), to other addresses, and its ACKs.

endmenu # MDB Cashless Device

menu "Backend"

    config VMFLOW_MQTT_BROKER_URI
        string "MQTT broker URI"
        default ""
        help
            Broker the device connects to, e.g. mqtt://192.168.1.50 for the bench Pi
            or mqtts://broker.example.com:8883 later. Required: the build fails while
            this is empty, so a fresh build can never fall back to a third-party broker.

    config VMFLOW_TOPIC_DOMAIN
        string "MQTT topic domain"
        default "vmflow.xyz"
        help
            Topic namespace (not a hostname). The device subscribes to
            <subdomain>.<domain>/rpc and publishes to domain.<domain>/<subdomain>/...
            Also used for the BLE device name. Keep it in sync with the backend and rpc.sh.

    config VMFLOW_OTA_BASE_URL
        string "OTA base URL"
        default ""
        help
            The ota RPC downloads <base>/<tag>/mdb-slave-esp32s3.bin, with tag "latest"
            when none is given. Leave empty to disable OTA.

    config VMFLOW_LOG_SECRETS
        bool "Log passkey and Wi-Fi password (dev builds only)"
        default n

endmenu # Backend

menu "Development provisioning"

    config VMFLOW_DEV_WIFI_SSID
        string "Wi-Fi SSID"
        default ""
        help
            Bench Wi-Fi network, applied at boot instead of BLE provisioning.
            Leave empty to use whatever the device has stored. Lives only in your
            local sdkconfig; don't commit it.

    config VMFLOW_DEV_WIFI_PASSWORD
        string "Wi-Fi password"
        default ""

    config VMFLOW_DEV_SUBDOMAIN
        string "Device subdomain (ID)"
        default ""
        help
            Device ID used in MQTT topics, e.g. 51. Set together with the passkey to
            override the identity stored in NVS. Leave both empty to use NVS.

    config VMFLOW_DEV_PASSKEY
        string "Device passkey (18 chars)"
        default ""
        help
            HMAC key for RPC signing. Must be exactly 18 characters. Use the same
            value in rpc.sh / the Pi script. Dev only; don't commit it.

endmenu # Development provisioning

menu "SIM7080G"

    config VMFLOW_MODEM_ENABLE
        bool "Probe for a SIM7080G modem at boot"
        default y
        help
            Power-cycles and syncs the SIM7080G (~8 s) before MQTT starts, and uses
            cellular (PPP) when it registers. Turn off on Wi-Fi-only boards so MQTT
            starts as soon as Wi-Fi has an IP.

    choice
        prompt "LTE Network Mode"
        default SIM7080G_CMNB_BOTH

        config SIM7080G_CMNB_CATM
            bool "Cat-M only"

        config SIM7080G_CMNB_NBIOT
            bool "NB-IoT only"

        config SIM7080G_CMNB_BOTH
            bool "Both (LTE-M + NB-IoT)"

    endchoice

    config SIM7080G_CMNB
        int
        default 1 if SIM7080G_CMNB_CATM
        default 2 if SIM7080G_CMNB_NBIOT
        default 3 if SIM7080G_CMNB_BOTH

    config SIM7080G_APN
        string "APN"
        default "lf.br"

endmenu # SIM7080G

endmenu # VMflow
```
